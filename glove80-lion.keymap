#define NUMPAD_LAYER 3
#define SYMBOL_LAYER 4


behaviors {
    // Similar to the "layer" key, use tap-dance for numpad
    // so the first tap (or hold) is a &mo and the second tap is a &to
    numpad: tap_dance_numpad {
        compatible = "zmk,behavior-tap-dance";
        label = "LAYER_TAP_DANCE_NUMPAD";
        #binding-cells = <0>;
        tapping-term-ms = <200>;
        bindings = <&mo NUMPAD_LAYER>, <&to NUMPAD_LAYER>;
    };

    symbol: tap_dance_symbol {
        compatible = "zmk,behavior-tap-dance";
        label = "LAYER_TAP_DANCE_SYMBOL";
        #binding-cells = <0>;
        tapping-term-ms = <200>;
        bindings = <&mo SYMBOL_LAYER>, <&to SYMBOL_LAYER>;
    };
};
